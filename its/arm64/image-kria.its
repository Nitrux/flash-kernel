## its/arm64/image-kria.its
```
/*
 * Simple U-Boot uImage source file containing a single kernel, ramdisk and FDT blob
 */

/dts-v1/;

/ {
    description = "Simple image with single Linux kernel, ramdisk and FDT blob";
    #address-cells = <1>;

    images {
        kernel-1 {
            description = "Ubuntu kernel";
            data = /incbin/("@@LINUX_IMAGE_FILE@@");
            type = "kernel";
            arch = "arm64";
            os = "linux";
            compression = "gzip";
            load = <0x00080000>;
            entry = <0x00080000>;
            hash-1 {
                algo = "sha1";
            };
        };

        ramdisk-1 {
            description = "Ubuntu ramdisk";
            data = /incbin/("@@INITRD_FILE@@");
            type = "ramdisk";
            arch = "arm64";
            os = "linux";
            compression = "none";
            hash-1 {
                algo = "sha1";
            };
        };

        fdt-1 {
            description = "Kria Device Tree blob";
            data = /incbin/("/usr/share/xlnx-kria-firmware/devicetree/system-top.dtb");
            type = "flat_dt";
            arch = "arm64";
            compression = "none";
            hash-1 {
                algo = "sha1";
            };
        };
    };

    configurations {
        default = "kria";
        kria {
            description = "Boot Ubuntu on kria SOM";
            kernel = "kernel-1";
            ramdisk = "ramdisk-1";
            fdt = "fdt-1";
            hash-1 {
                algo = "sha1";
            };
        };
    };
};
```

## its/arm64/image-zcu.its
```
/*
 * Simple U-Boot uImage source file containing a single kernel, ramdisk and FDT blob
 */

/dts-v1/;

/ {
    description = "Simple image with single Linux kernel, ramdisk and FDT blob";
    #address-cells = <1>;

    images {
        kernel-1 {
            description = "Ubuntu kernel";
            data = /incbin/("@@LINUX_IMAGE_FILE@@");
            type = "kernel";
            arch = "arm64";
            os = "linux";
            compression = "gzip";
            load = <0x00080000>;
            entry = <0x00080000>;
            hash-1 {
                algo = "sha1";
            };
        };

        ramdisk-1 {
            description = "Ubuntu ramdisk";
            data = /incbin/("@@INITRD_FILE@@");
            type = "ramdisk";
            arch = "arm64";
            os = "linux";
            compression = "none";
            hash-1 {
                algo = "sha1";
            };
        };
    };

    configurations {
        default = "zcu";
        zcu {
            description = "Boot Ubuntu on zcu board";
            kernel = "kernel-1";
            ramdisk = "ramdisk-1";
            hash-1 {
                algo = "sha1";
            };
        };
    };
};
```
